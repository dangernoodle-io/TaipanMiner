## components/asic/Kconfig
```kconfig
menu "Vcore-collapse watchdog (TA-318)"

    config TM_VCORE_WATCHDOG
        bool "Enable vcore-collapse watchdog (bb_power_health)"
        default n
        help
            Monitor the TPS546 vcore rail every 5 s using bb_vcore_wd_eval().
            On BB_VCORE_WD_RECOVER: increment NVS burst counter and esp_restart()
            to clear a latched OC/UV fault without a physical power-cycle.
            On BB_VCORE_WD_BACKOFF: log and hold (burst limit reached).
            Bitaxe (ASIC) boards only — enabled via sdkconfig/bitaxe-*. The
            asic_task.c watchdog glue is additionally gated by #ifdef ASIC_CHIP,
            so it is a no-op on non-ASIC builds even if this is forced on.
            NOTE: ASIC_BM1368/ASIC_BM1370 are C preprocessor build-flag defines,
            not Kconfig symbols, so a `depends on` cannot gate on them (Kconfig
            treats undefined symbols as n, which silently compiled the watchdog
            OUT on every board — the original TA-318 bug). Gate per-board in
            sdkconfig instead.

endmenu

menu "TPS546 VIN UVLO thresholds"

    config TM_TPS546_VIN_ON_MV
        int "TPS546 VIN_ON threshold (mV)"
        range 3500 18000
        default 4400
        help
            TPS546 VIN_ON (turn-on) threshold in mV. The regulator enables when VIN rises above
            this. Relaxed from AxeOS 4800 to tolerate non-OEM/sagging supplies (ESP-Miner #1188).
            Set just above VIN_OFF for hysteresis. Note the TPS546's rated minimum input is ~4.5V;
            values below that trade spec-margin for transient-sag tolerance.

    config TM_TPS546_VIN_OFF_MV
        int "TPS546 VIN_OFF threshold (mV)"
        range 3500 18000
        default 4200
        help
            TPS546 VIN_OFF (turn-off / UVLO) threshold in mV. The regulator shuts off when VIN
            sags below this. Relaxed from AxeOS 4500, which false-trips and latches on supplies
            that droop under load (#1188). Tune ~0.3-0.5V below the rail voltage measured at the
            miner under full load.

endmenu
```

## components/knot/Kconfig
```kconfig
menu "Knot peer discovery"

config KNOT_ENABLED
    bool "Enable knot peer-discovery table"
    default WEBUI_MINING_UI
    help
      Compile in the knot component: mDNS browse, peer table (g_peer_table[32]),
      and the /api/knot route. Enabled by default when the mining web UI is on
      (WEBUI_MINING_UI=y) and disabled on headless boards where the dashboard is
      not served. The ~8.3 KB .bss peer table and associated code are removed from
      the binary when this is off.

      Knot is informational-only (feeds /api/knot for the dashboard dashboard) and
      has no impact on mining, stratum, WiFi, or OTA.

endmenu
```

## components/mining/Kconfig
```kconfig
menu "Mining"

config MINING_UNICORE_YIELD_MASK
    hex "Mining unicore yield mask (nonces between yields = mask + 1)"
    default 0x3FFF
    depends on FREERTOS_UNICORE
    help
      Bit mask AND'd against the nonce counter to trigger a vTaskDelay yield
      in the mining hot loop. Default 0x3FFF yields every 16K nonces. Lower
      = more frequent yields (better network/UI responsiveness, lower
      throughput). Higher = fewer yields (higher throughput, less responsive).
      Empirically tuned via the TA-401 sweep.

config MINING_PIN_HOTLOOP_DATA
    bool "Pin mining hot-loop data to cache-aligned static storage"
    default y
    help
      Place the per-nonce mining hot-loop data (block2 and the HW SHA backend
      context) in cache-line-aligned static (BSS) storage instead of on the
      stack. Pinning isolates these on fixed D-cache lines, protecting the hot
      loop from layout shifts caused by future feature additions (TA-392), and
      benefits boards with a larger per-nonce working set (ESP32-S3 / AHB SHA).

      Disable on ESP32-D0 (classic WROOM-32): after the TA-396 early-reject
      byte-order fix its reject-path working set is tiny, and stack placement
      measured ~1.5% faster than the aligned static (445 -> 452 kH/s).

endmenu
```

## components/webui/Kconfig
```kconfig
menu "Web UI"

config WEBUI_MINING_UI
    bool "Serve the mining-mode web dashboard (SPA)"
    default y
    help
      Register the static mining dashboard SPA on the HTTP server. Assets are
      served as pre-gzipped blobs straight from flash (the browser decompresses),
      so the runtime heap cost is just the httpd response buffers.

      The /api/* routes are always registered regardless of this option, so a
      headless device still exposes stats, pool config, and OTA endpoints.

      Disable only on parts too heap-constrained to serve the dashboard without
      risking OOM (the no-PSRAM ESP32-S2 Mini). The C3 SuperMini and dual-core
      boards leave this on.

endmenu
```
