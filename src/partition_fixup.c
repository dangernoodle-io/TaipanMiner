#ifdef ESP_PLATFORM

#include "partition_fixup.h"
#include "partition_fixup_decision.h"
#include <string.h>
#include "esp_flash.h"
#include "esp_ota_ops.h"
#include "bb_system.h"
#include "bb_log.h"

static const char *TAG = "partition_fixup";

// Embedded expected partition table (generated by embed_partitions.py)
extern const uint8_t g_partitions_bin[];
extern const unsigned int g_partitions_bin_len;

#define PARTITION_TABLE_ADDR  0x8000
#define OTA_0_ADDR            0x20000
#define OTA_1_ADDR            0x200000
#define OTA_SLOT_SIZE         0x1E0000
#define OTADATA_ADDR          0xF000
#define OTADATA_SIZE          0x2000
#define COPY_CHUNK_SIZE       4096

// cppcheck-suppress unusedFunction ; called from src/main.c (cross-TU)
static void partition_fixup_check_impl(uint8_t *buf)
{
    // Read current partition table from flash
    bool live_table_ok = false;
    esp_err_t err = esp_flash_read(NULL, buf, PARTITION_TABLE_ADDR, g_partitions_bin_len);
    if (err == ESP_OK) {
        live_table_ok = true;
    } else {
        bb_log_e(TAG, "failed to read partition table: %s", esp_err_to_name(err));
    }

    // Find where we're currently running from
    const esp_partition_t *running = esp_ota_get_running_partition();
    uint32_t running_addr = running ? (uint32_t)running->address : 0;

    // Decide whether and how to fix up the partition layout
    partition_fixup_decision_t d = partition_fixup_decide(
        g_partitions_bin, g_partitions_bin_len,
        live_table_ok, live_table_ok ? buf : NULL,
        running_addr, OTA_0_ADDR);

    switch (d.action) {
    case PARTITION_FIXUP_SKIP_NO_TABLE:
    case PARTITION_FIXUP_SKIP_TABLE_MATCHES:
        return;

    case PARTITION_FIXUP_NEEDS_COPY_AND_REWRITE:
        bb_log_w(TAG, "foreign partition table detected — starting fixup");
        if (running == NULL) {
            bb_log_e(TAG, "cannot determine running partition, aborting fixup");
            return;
        }

        bb_log_i(TAG, "running from 0x%08" PRIx32 " (size 0x%08" PRIx32 ")",
                 (uint32_t)running->address, (uint32_t)running->size);
        bb_log_i(TAG, "copying firmware from 0x%08" PRIx32 " to 0x%08" PRIx32,
                 (uint32_t)running->address, (uint32_t)OTA_0_ADDR);
        bb_log_i(TAG, "copying firmware from 0x%08" PRIx32 " to 0x%08" PRIx32,
                 (uint32_t)running->address, (uint32_t)OTA_0_ADDR);

        uint32_t copy_size = running->size;

        // Erase-and-copy one sector at a time to avoid destroying source
        // when dest and source regions overlap (e.g. dest 0x20000-0x120000
        // overlaps source at 0x110000+).
        for (uint32_t offset = 0; offset < copy_size; offset += COPY_CHUNK_SIZE) {
            uint32_t len = COPY_CHUNK_SIZE;
            if (offset + len > copy_size) {
                len = copy_size - offset;
            }

            err = esp_flash_read(NULL, buf, running->address + offset, len);
            if (err != ESP_OK) {
                bb_log_e(TAG, "read failed at offset 0x%" PRIx32 ": %s", offset, esp_err_to_name(err));
                return;
            }

            err = esp_flash_erase_region(NULL, OTA_0_ADDR + offset, COPY_CHUNK_SIZE);
            if (err != ESP_OK) {
                bb_log_e(TAG, "erase failed at offset 0x%" PRIx32 ": %s", offset, esp_err_to_name(err));
                return;
            }

            err = esp_flash_write(NULL, buf, OTA_0_ADDR + offset, len);
            if (err != ESP_OK) {
                bb_log_e(TAG, "write failed at offset 0x%" PRIx32 ": %s", offset, esp_err_to_name(err));
                return;
            }
        }

        bb_log_i(TAG, "firmware copy complete (%" PRIu32 " bytes)", copy_size);
        // Fall through to rewrite and dup
        __attribute__((fallthrough));

    case PARTITION_FIXUP_NEEDS_REWRITE_ONLY:
        bb_log_w(TAG, "foreign partition table detected — starting fixup");

        // Write our partition table at 0x8000 (one 4KB sector)
        // Requires CONFIG_SPI_FLASH_DANGEROUS_WRITE_ALLOWED=y in sdkconfig
        bb_log_i(TAG, "writing partition table at 0x%x", PARTITION_TABLE_ADDR);
        err = esp_flash_erase_region(NULL, PARTITION_TABLE_ADDR, COPY_CHUNK_SIZE);
        if (err != ESP_OK) {
            bb_log_e(TAG, "erase partition table failed: %s", esp_err_to_name(err));
            return;
        }

        err = esp_flash_write(NULL, g_partitions_bin, PARTITION_TABLE_ADDR, g_partitions_bin_len);
        if (err != ESP_OK) {
            bb_log_e(TAG, "write partition table failed: %s", esp_err_to_name(err));
            return;
        }

        // Duplicate ota_0 into ota_1 for rollback safety
        // Prevents anti-rollback from booting into garbage if mark-valid doesn't fire
        bb_log_i(TAG, "duplicating ota_0 -> ota_1 for rollback safety");
        for (uint32_t offset = 0; offset < OTA_SLOT_SIZE; offset += COPY_CHUNK_SIZE) {
            uint32_t len = COPY_CHUNK_SIZE;
            if (offset + len > OTA_SLOT_SIZE) {
                len = OTA_SLOT_SIZE - offset;
            }

            err = esp_flash_read(NULL, buf, OTA_0_ADDR + offset, len);
            if (err != ESP_OK) {
                bb_log_e(TAG, "ota_1 copy: read failed at offset 0x%" PRIx32 ": %s", offset, esp_err_to_name(err));
                return;
            }

            err = esp_flash_erase_region(NULL, OTA_1_ADDR + offset, COPY_CHUNK_SIZE);
            if (err != ESP_OK) {
                bb_log_e(TAG, "ota_1 copy: erase failed at offset 0x%" PRIx32 ": %s", offset, esp_err_to_name(err));
                return;
            }

            err = esp_flash_write(NULL, buf, OTA_1_ADDR + offset, len);
            if (err != ESP_OK) {
                bb_log_e(TAG, "ota_1 copy: write failed at offset 0x%" PRIx32 ": %s", offset, esp_err_to_name(err));
                return;
            }
        }
        bb_log_i(TAG, "ota_1 duplication complete (%" PRIu32 " bytes)", OTA_SLOT_SIZE);

        // Erase otadata (8KB = two 4KB sectors at 0xF000)
        // All 0xFF means "boot from ota_0"
        bb_log_i(TAG, "erasing otadata at 0x%x (%" PRIu32 " bytes)", OTADATA_ADDR, (uint32_t)OTADATA_SIZE);
        err = esp_flash_erase_region(NULL, OTADATA_ADDR, OTADATA_SIZE);
        if (err != ESP_OK) {
            bb_log_e(TAG, "erase otadata failed: %s", esp_err_to_name(err));
            return;
        }

        bb_log_w(TAG, "partition fixup complete — rebooting");
        bb_system_restart();
        break;
    }
}

#include <stdlib.h>

void partition_fixup_check(void)
{
    uint8_t *buf = malloc(4096);
    if (!buf) {
        bb_log_e(TAG, "alloc failed");
        return;
    }
    partition_fixup_check_impl(buf);
    free(buf);
}

#else
// Native build: no-op
#include "partition_fixup.h"
void partition_fixup_check(void) {}
#endif
